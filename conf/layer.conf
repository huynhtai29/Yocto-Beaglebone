## conf/layer.conf
```bitbake
# We have a conf and classes directory, add to BBPATH
BBPATH .= ":${LAYERDIR}"

# We have recipes-* directories, add to BBFILES
BBFILES += "${LAYERDIR}/recipes-*/*/*.bb \
            ${LAYERDIR}/recipes-*/*/*.bbappend"

BBFILE_COLLECTIONS += "meta-beaglebone"
BBFILE_PATTERN_meta-beaglebone = "^${LAYERDIR}/"
BBFILE_PRIORITY_meta-beaglebone = "6"

LAYERDEPENDS_meta-beaglebone = "core"
LAYERSERIES_COMPAT_meta-beaglebone = "dunfell"
```

## conf/machine/beagleboneblack.conf
```bitbake
#@TYPE: Machine
#@NAME: BeagleBone-Black machine
#@DESCRIPTION: Machine configuration for the http://beagleboard.org/bone board

require include/ti33x.inc

KERNEL_DEVICETREE = "am335x-boneblack.dtb"

# Only has DVI connector for external screen
MACHINE_GUI_CLASS = "bigscreen"

SERIAL_CONSOLES = "115200;ttyS0"

IMAGE_INSTALL_append = " kernel-devicetree kernel-image-uimage"

# Refine the list of device targets for ti-pdk class recipes
TI_PDK_LIMIT_BOARDS = "bbbAM335x"
```
